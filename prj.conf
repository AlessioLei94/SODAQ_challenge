## CMakeLists.txt
```
# SPDX-License-Identifier: Apache-2.0

cmake_minimum_required(VERSION 3.20.0)

find_package(Zephyr REQUIRED HINTS $ENV{ZEPHYR_BASE})
project(SODAQ_challenge)

target_sources(app PRIVATE src/main.c src/control_task.c src/counter_task.c
                            src/leds.c src/btns.c)
include_directories(include)
```

## prj.conf
```kconfig
# nothing here

CONFIG_LOG=y

CONFIG_WATCHDOG=y
CONFIG_WDT_LOG_LEVEL_DBG=y
CONFIG_WDT_DISABLE_AT_BOOT=y

CONFIG_TASK_WDT=y
CONFIG_TASK_WDT_CHANNELS=2

CONFIG_THREAD_NAME=y
CONFIG_HWINFO=y
```

## src/main.c
```c
/*
 * Main file of the project containing the WDT initialization and an infinite
 * loop that just prints a message and feeds the wdt
 */
#include <zephyr.h>
#include <device.h>
#include <sys/printk.h>
#include <sys/reboot.h>
#include <drivers/watchdog.h>
#include <drivers/hwinfo.h>
#include <task_wdt/task_wdt.h>

#include <leds.h>
#include <btns.h>

/*
 * If the devicetree has a watchdog node, we get the watchdog device
 * from there. Otherwise, the task watchdog will be used without a
 * hardware watchdog fallback.
 */
#if DT_NODE_HAS_STATUS(DT_ALIAS(watchdog0), okay)
#define WDT_NODE DT_ALIAS(watchdog0)
#elif DT_HAS_COMPAT_STATUS_OKAY(nordic_nrf_watchdog)
#define WDT_NODE DT_COMPAT_GET_ANY_STATUS_OKAY(nordic_nrf_watchdog)
#endif

/*
 * Main function
 * 1. Get reset cause from hwinfo module then reset flags and print the cause
 * 2. If WDT_NODE is defined get the hardware wdt device struct using the node_id and initialize it
 * 3. Add new channel to Task WDT
 * 4. Infinite loop printing a message and feeding the wdt
 */
void main(void)
{
	uint32_t reset_cause = 0;

	/*
	 * Get info about last reset's cause.
	 * Do not return in case this operation is not supported (ret == -ENOTSUP)
	 */
	int ret = hwinfo_get_reset_cause(&reset_cause);
	if(ret == -ENOTSUP) {
		printk("hwinfo_get_reset_cause() not supported, value will be zero\n");
	} else if(ret != 0) {
		printk("hwinfo_get_reset_cause() failed (%d)\n", ret);
		return;
	}

	//Clear reset flags after reading them, so they won't accumulate from different resets
	hwinfo_clear_reset_cause();

	printk("SODAQ Challenge fw booted\nLast reset cause was %d\n", reset_cause);

#ifdef WDT_NODE
	const struct device *hw_wdt = DEVICE_DT_GET(WDT_NODE);
#else
	const struct device *hw_wdt = NULL;
#endif

	//Init LED
	if(led_init() < 0) {
		return;
	}

	//Init BTN
	if(btns_init() < 0) {
		return;
	}

 	if(!device_is_ready(hw_wdt)) {
		printk("WDT %s not ready\n", hw_wdt->name);
		hw_wdt = NULL;
	}

	ret = task_wdt_init(hw_wdt);
	if(ret != 0) {
		printk("task_wdt_init() failed (%d)\n", ret);
		return;
	}

	//Add wdt channel for main task, passing NULL instead of cb triggers reset
	int wdt_id = task_wdt_add(1100U, NULL, NULL);
	if(wdt_id < 0) {
		printk("task_wdt_add() failed (%d)\n", wdt_id);
		return;
	}

	/*
	 * Infinite loop that just prints a message to stdout
	 * and feeds the task wdt once every second
	 */
	while(1) {
		printk("Main task is alive :)\n");
		task_wdt_feed(wdt_id);
		k_sleep(K_MSEC(1000));
	}
}
```

## include/btns.h
```c
#ifndef BTNS_H_
#define BTNS_H_

#include <drivers/gpio.h>

/*
 * Register callback function called when the button0 is pressed
 *
 * Return 0 on success, negative number in case of error
 */
int register_btn1_cb(gpio_callback_handler_t cb);

/*
 * Register callback function called when the button1 is pressed
 *
 * Return 0 on success, negative number in case of error
 */
int register_btn2_cb(gpio_callback_handler_t cb);

/*
 * Initialize BTN driver
 *
 * Return 0 on success, negative number in case of error
 */
int btns_init(void);

#endif //BTNS_H_
```

## include/leds.h
```c
#ifndef LEDS_H_
#define LEDS_H_

#include <stdbool.h>
#include <stdint.h>

#define LEDS_NUMBER		4

/*
 * Set led status to ON or OFF
 *
 * Return 0 on success, negative number in case of error
 */
int led_set_status(uint8_t dev_index, bool status);

/*
 * Initialize LED driver
 *
 * Return 0 on success, negative number in case of error
 */
int led_init(void);

#endif //LEDS_H_
```

## src/btns.c
```c
/*
 * File representing a BTN driver.
 * Simple implemetation because only two buttons are handled with basic "on press" callback
 */
#include <btns.h>

/*
 * Get buttons configuration from the devicetree sw0/sw1 alias. This is mandatory.
 */
#define SW0_NODE	DT_ALIAS(sw0)
#if !DT_NODE_HAS_STATUS(SW0_NODE, okay)
#error "Unsupported board: sw0 devicetree alias is not defined"
#endif

#define SW1_NODE	DT_ALIAS(sw1)
#if !DT_NODE_HAS_STATUS(SW1_NODE, okay)
#error "Unsupported board: sw1 devicetree alias is not defined"
#endif

static const struct gpio_dt_spec button1 = GPIO_DT_SPEC_GET_OR(SW0_NODE, gpios, {0});
static const struct gpio_dt_spec button2 = GPIO_DT_SPEC_GET_OR(SW1_NODE, gpios, {0});

int register_btn1_cb(gpio_callback_handler_t cb) {
	static struct gpio_callback button0_cb_data;
    static bool registered = false;

    if(registered) {
        printk("Button0 cn already registered!\n");
        return -1;
    }

    gpio_init_callback(&button0_cb_data, cb, BIT(button1.pin));
    int ret = gpio_add_callback(button1.port, &button0_cb_data);
    if(ret != 0) {
        printk("gpio_add_callback failed (%d)\n", ret);
        return ret;
    }

    registered = true;

    return ret;
}

int register_btn2_cb(gpio_callback_handler_t cb) {
	static struct gpio_callback button1_cb_data;
    static bool registered = false;

    if(registered) {
        printk("Button1 cn already registered!\n");
        return -1;
    }

    gpio_init_callback(&button1_cb_data, cb, BIT(button2.pin));
    int ret = gpio_add_callback(button2.port, &button1_cb_data);
    if(ret != 0) {
        printk("gpio_add_callback failed (%d)\n", ret);
        return ret;
    }

    registered = true;

    return ret;
}

int btns_init(void) {
    int ret;

	//Initialize button 0
	if (!device_is_ready(button1.port)) {
		printk("Error: button1 device %s is not ready\n",
		       button1.port->name);
		return -1;
	}

	ret = gpio_pin_configure_dt(&button1, GPIO_INPUT);
	if (ret != 0) {
		printk("Error %d: failed to configure %s pin %d\n",
		       ret, button1.port->name, button1.pin);
		return ret;
	}

	ret = gpio_pin_interrupt_configure_dt(&button1,
					      GPIO_INT_EDGE_TO_ACTIVE);
	if (ret != 0) {
		printk("Error %d: failed to configure interrupt on %s pin %d\n",
			ret, button1.port->name, button1.pin);
		return ret;
	}

	//Initialize button 1
	if (!device_is_ready(button2.port)) {
		printk("Error: button1 device %s is not ready\n",
		       button2.port->name);
		return -1;
	}

	ret = gpio_pin_configure_dt(&button2, GPIO_INPUT);
	if (ret != 0) {
		printk("Error %d: failed to configure %s pin %d\n",
		       ret, button2.port->name, button2.pin);
		return ret;
	}

	ret = gpio_pin_interrupt_configure_dt(&button2,
					      GPIO_INT_EDGE_TO_ACTIVE);
	if (ret != 0) {
		printk("Error %d: failed to configure interrupt on %s pin %d\n",
			ret, button2.port->name, button2.pin);
		return ret;
	}

	printk("Set up button2 at %s pin %d\n", button2.port->name, button2.pin);

    return ret;
}
```

## src/control_task.c
```c
/* 
 * File containing the implementation of a control task.
 * Controls a LED, feeds the WDT and can be stopped pressing a button
 */
#include <zephyr.h>
#include <sys/reboot.h>
#include <task_wdt/task_wdt.h>

#include <leds.h>
#include <btns.h>

#define SLEEP_TIME_MS   	200U
#define WDT_RESET_TIME_MS	210U

static bool stop_task = false;

/*
 * Task WDT callback function
 * 
 * - channel_id: id of the channel the timeout refers to
 * - user_data: parameter used to pass the thread id in order to print it
 */
void task_wdt_cb(int channel_id, void *user_data) {
	printk("Task watchdog channel %d callback, thread: %s didn't reset WDT in time\n",
		channel_id, k_thread_name_get((k_tid_t)user_data));

	/*
	 * Here is possible to call task_wdt_feed(channel_id) in
	 * case the problem can be resolved.
	 *
	 * Otherwise we can perform some cleanup if needed and reset the device.
	 */

	printk("Resetting device...\n");

	sys_reboot(SYS_REBOOT_COLD);
}

/*
 * BTN pressed callback used to flip a booleanflag that if true is going to block
 * the control task forever triggering the WDT
 */
void button0_pressed_cb(const struct device *port, struct gpio_callback *cb, uint32_t pins) {
	printk("Button0 pressed cb\n");

	stop_task = !stop_task;
}

/*
 * Control task function.
 * Initialize led, add a new channel to the task WDT then enter infinite loop
 * in which the LED status is switched between ON and OFF and the WDT is fed.
 */
void control_task_fun(void) {
	bool led_status[LEDS_NUMBER] = {true, true, true, true};
	uint8_t counter = 0;
	int ret = 0;

	printk("control_task started!\n");

	//Register button pressed cb
	if(register_btn1_cb(button0_pressed_cb) < 0) {
		return;
	}

	//Add wdt channel for control task, giving a callback to call when wdt resets
	//and passing the thread id to the callback as an argument
	int wdt_id = task_wdt_add(WDT_RESET_TIME_MS, task_wdt_cb, (void *)k_current_get());
	if(wdt_id < 0) {
		printk("task_wdt_add() failed (%d)\n", wdt_id);
		return;
	}

	while(1) {
		if(stop_task) {
			k_sleep(K_FOREVER);
		}

		ret = led_set_status(counter, led_status[counter]);
		if(ret != 0) {
			printk("Failed to set LED to status %d, trying again\n", led_status[counter]);
		} else {
			led_status[counter] = !led_status[counter];
		}

		counter = (counter + 1) % LEDS_NUMBER;

		task_wdt_feed(wdt_id);
		k_sleep(K_MSEC(SLEEP_TIME_MS));
	}
}

/*
 * Define task at compile time and starts it 1 sec after boot
 */
K_THREAD_DEFINE(control_task, 1024, control_task_fun, NULL, NULL, NULL, 0, 0, 1000U);
```

## src/counter_task.c
```c
/* 
 * File containing the implementation of a counter task.
 * Increase a counter every time BTN2 is pressed and print the count every second
 */
#include <zephyr.h>
#include <sys/reboot.h>
#include <task_wdt/task_wdt.h>

#include <btns.h>

//Define mutex at compile time, used to control the access to counter variable
K_MUTEX_DEFINE(counter_mux);

static int counter = 0;

/*
 * BTN pressed callback used to increase a counter
 */
void button1_pressed_cb(const struct device *port, struct gpio_callback *cb, uint32_t pins) {
	printk("Button1 pressed cb\n");
    
    if(k_mutex_lock(&counter_mux, K_MSEC(100U)) == 0) {
    	counter++;

        k_mutex_unlock(&counter_mux);
    } else {
        printk("Failed to get lock to increase value!");
    }
}

/*
 * Counter task function.
 * Register BTN2 pressed callback that increases a counter.
 * Infinite loop that prints the value of the counter.
 * Access to the counter is controlled by a mutex
 */
void counter_task_fun(void) {
    int ret = register_btn2_cb(button1_pressed_cb);
    if(ret != 0) {
        printk("register_btn2_cb failed (%d)", ret);
        return;
    }

    printk("counter_task_fun started!\n");

    //Add wdt channel for counter task, passing NULL instead of cb triggers reset
    int wdt_id = task_wdt_add(1200U, NULL, NULL);

    while(1) {
        if(k_mutex_lock(&counter_mux, K_MSEC(100U)) == 0) {
            printk("Counter task count is %d\n", counter);

            k_mutex_unlock(&counter_mux);
        } else {
            printk("Failed to get lock to print value!");
        }

        task_wdt_feed(wdt_id);
        k_sleep(K_MSEC(1000U));
    }
}

//Define thread at compile time
K_THREAD_DEFINE(counter_task, 1024, counter_task_fun, NULL, NULL, NULL, 0, 0, 1000);
```

## src/led_control.c
```c
/* 
 * File containing a task that turns on and off a LED using different colors
 */
#include <zephyr.h>
#include <sys/reboot.h>
#include <task_wdt/task_wdt.h>
#include <drivers/gpio.h>

#define SLEEP_TIME_MS   	200U
#define WDT_RESET_TIME_MS	500U

/* The devicetree node identifier for the "led0" alias. */
#define LED0_NODE DT_ALIAS(led0)

#if DT_NODE_HAS_STATUS(LED0_NODE, okay)
#define LED0	DT_GPIO_LABEL(LED0_NODE, gpios)
#define PIN		DT_GPIO_PIN(LED0_NODE, gpios)
#define FLAGS	DT_GPIO_FLAGS(LED0_NODE, gpios)
#else
/* A build error here means your board isn't set up to blink an LED. */
#error "Unsupported board: led0 devicetree alias is not defined"
#define LED0	""
#define PIN		0
#define FLAGS	0
#endif

const struct device *dev;

/*
 * Task WDT callback function
 * 
 * - channel_id: id of the channel the timeout refers to
 * - user_data: parameter used to pass the thread id in order to print it
 */
void task_wdt_cb(int channel_id, void *user_data) {
	printk("Task watchdog channel %d callback, thread: %s\n",
		channel_id, k_thread_name_get((k_tid_t)user_data));

	/*
	 * If the issue could be resolved, call task_wdt_feed(channel_id) here
	 * to continue operation.
	 *
	 * Otherwise we can perform some cleanup and reset the device.
	 */

	printk("Resetting device...\n");

	sys_reboot(SYS_REBOOT_COLD);
}

/*
 * Init function for LED control task. Retrieve the device using its name and configure GPIO
 * 
 * Return 0 on success, -1 for failure (could be customised returning different negative numbers)
 */
int led_control_init(void) {
	dev = device_get_binding(LED0);
	if (dev == NULL) {
		printk("device_get_binding() failed");
		return -1;
	}

	int ret = gpio_pin_configure(dev, PIN, GPIO_OUTPUT_ACTIVE | FLAGS);
	if (ret < 0) {
		printk("gpio_pin_configure() failed (%d)", ret);
		return -1;
	}

	return 0;
}

/*
 * LED's task function.
 * Initialize led control, add a new channel to the task WDT then enter infinite loop
 * in which the LED status is switched between ON and OFF and the WDT is fed.
 */
void led_control_task(void) {
	bool led_status = true;

	printk("control_task started!");

	if(led_control_init() < 0) {
		return;
	}

	int wdt_id = task_wdt_add(WDT_RESET_TIME_MS, task_wdt_cb, (void *)k_current_get());
	if(wdt_id < 0) {
		printk("task_wdt_add() failed (%d)", wdt_id);
		return;
	}

	while(1) {
		//TODO: Put some condition that if true blocks the task here (BTN pressed, time based, else)
		gpio_pin_set(dev, PIN, (int)led_status);
		led_status = !led_status;

		task_wdt_feed(wdt_id);
		k_sleep(K_MSEC(SLEEP_TIME_MS));
	}
}

/*
 * Define task at compile time and starts it 1 sec after boot
 */
K_THREAD_DEFINE(led_task, 1024, led_control_task, NULL, NULL, NULL, 0, 0, 1000U);
```

## src/leds.c
```c
/*
 * File representing a LED driver.
 * Simple implemetation because only one LED is initialized and handled,
 * could be extended to handle more than one.
 */
#include <leds.h>

#include <drivers/gpio.h>

/* The devicetree node identifier for the "led0" alias. */
#define LED0_NODE DT_ALIAS(led0)
#define LED1_NODE DT_ALIAS(led1)
#define LED2_NODE DT_ALIAS(led2)
#define LED3_NODE DT_ALIAS(led3)

#if DT_NODE_HAS_STATUS(LED0_NODE, okay)
#define LED0	DT_GPIO_LABEL(LED0_NODE, gpios)
#define PIN0	DT_GPIO_PIN(LED0_NODE, gpios)
#define FLAGS0	DT_GPIO_FLAGS(LED0_NODE, gpios)
#else
/* A build error here means your board isn't set up to blink an LED. */
#error "Unsupported board: led0 devicetree alias is not defined"
#define LED0	""
#define PIN0	0
#define FLAGS0	0
#endif

#if DT_NODE_HAS_STATUS(LED1_NODE, okay)
#define LED1	DT_GPIO_LABEL(LED1_NODE, gpios)
#define PIN1	DT_GPIO_PIN(LED1_NODE, gpios)
#define FLAGS1	DT_GPIO_FLAGS(LED1_NODE, gpios)
#else
/* A build error here means your board isn't set up to blink an LED. */
#error "Unsupported board: led1 devicetree alias is not defined"
#define LED1	""
#define PIN1	0
#define FLAGS1	0
#endif

#if DT_NODE_HAS_STATUS(LED2_NODE, okay)
#define LED2	DT_GPIO_LABEL(LED2_NODE, gpios)
#define PIN2	DT_GPIO_PIN(LED2_NODE, gpios)
#define FLAGS2	DT_GPIO_FLAGS(LED2_NODE, gpios)
#else
/* A build error here means your board isn't set up to blink an LED. */
#error "Unsupported board: led2 devicetree alias is not defined"
#define LED2	""
#define PIN2	0
#define FLAGS2	0
#endif

#if DT_NODE_HAS_STATUS(LED3_NODE, okay)
#define LED3	DT_GPIO_LABEL(LED3_NODE, gpios)
#define PIN3	DT_GPIO_PIN(LED3_NODE, gpios)
#define FLAGS3	DT_GPIO_FLAGS(LED3_NODE, gpios)
#else
/* A build error here means your board isn't set up to blink an LED. */
#error "Unsupported board: led3 devicetree alias is not defined"
#define LED3	""
#define PIN3	0
#define FLAGS3	0
#endif

static const struct device *devs[LEDS_NUMBER];
static char *dev_names[LEDS_NUMBER] = {LED0, LED1, LED2, LED3};
static gpio_pin_t pins[LEDS_NUMBER] = {PIN0, PIN1, PIN2, PIN3};
static gpio_flags_t flags[LEDS_NUMBER] = {FLAGS0, FLAGS1, FLAGS2, FLAGS3};

int led_set_status(uint8_t dev_index, bool status) {
	if(dev_index >= LEDS_NUMBER) {
		printk("Invalid LED index %d\n", dev_index);
		return -1;
	}

    return gpio_pin_set(devs[dev_index], pins[dev_index], (int)status);
}

/*
 * Init function for LED driver. Retrieve the device using its name and configure GPIO
 * 
 * Return 0 on success, -1 for failure (could be customised returning different negative numbers)
 */
int led_init(void) {
	int ret = 0;

	for (int i = 0; i < LEDS_NUMBER ; i++) {
		devs[i] = device_get_binding(dev_names[i]);
		if (devs[i] == NULL) {
			printk("device_get_binding() failed\n");
			return -1;
		}

		ret = gpio_pin_configure(devs[i], pins[i], GPIO_OUTPUT_ACTIVE | flags[i]);
		if (ret < 0) {
			printk("gpio_pin_configure() failed (%d)\n", ret);
			return ret;
		}
	}

	return ret;
}
```
